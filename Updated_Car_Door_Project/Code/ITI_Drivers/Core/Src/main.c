/*******************************************************************************************************
 *******************************************************************************************************
AUTHOR  : MOHAMED ABDELAZIZ
MICRO   : STM32F401CCU6
LAYER   : APPLICATION
File    : Main File
Version : 1.0
Date	: 14/8/2023
********************************************************************************************************
********************************************************************************************************/

/*******************************************************************************************************/
/**************************************** DRIVER INCLUDES **********************************************/
/*******************************************************************************************************/

#include "HAL/DC_Motor/DC_Motor.h"
#include "HAL/Comms/Communication.h"
#include "HAL/LED_Control/LED_Control.h"
#include "HAL/PB_Control/PB_Control.h"

/*******************************************************************************************************/
/**************************************** GLOBAL VARIABLES *********************************************/
/*******************************************************************************************************/

u8 g_Car_ON = 0;

/*******************************************************************************************************/
/***************************************** MAIN FUNCTIONS **********************************************/
/*******************************************************************************************************/


void PB_vPressed(void){
	g_Car_ON = 1;
}



int main(void)
{
	u8 data = 1;
	/************ Clock Initialization ****************/

	MRCC_vInit();

	/************* PB Initialization *****************/

	PB_InterruptInit(PORT_A, PIN_0, PULL_UP, FALLING_TRIGGER, PB_vPressed, 0, 0);

	/************* LED Initialization *****************/

	LED_init(PORT_A, PIN_4);

	/*********** DC Motor Initialization *************/

	DC_Motor_Init();

	/************* USART Configuration ****************/

	Comms_Init(USART_1, 9600);

	while (1){
		if(g_Car_ON == 1){
			data = 2;
			DC_Motor_Rotate(CW);
			LED_ON(PORT_A, PIN_4);
			Comms_Read_Write(USART_1, &data, 1, 0, WRITE);
		}
		else{
			data = 1;
			DC_Motor_Rotate(STOP);
			LED_OFF(PORT_A, PIN_4);
			Comms_Read_Write(USART_1, &data, 1, 0, WRITE);
		}
		if(PB_Read(_GPIOA_PORT, _PIN_0)){
			g_Car_ON = 0;
		}
	}
}
